/*
 * Copyright (c) 2022 The ZMK Contributors
 *
 * SPDX-License-Identifier: MIT
 */

&nice_view_spi {
    status = "okay";
    nice_view: ls0xx@0 {
        compatible = "sharp,ls0xx";
        spi-max-frequency = <1000000>;
        reg = <0>;
        width = <160>;
        height = <68>;
    };
};

/ {
    chosen {
        zephyr,display = &nice_view;
    };
};

    now_playing_dev: now_playing_dev {
        compatible = "zmk,output-split-output-relay";
        #binding-cells = <0>;
        status = "okay";
    };

    now_playing_relay: now_playing_relay {
        compatible = "zmk,split-peripheral-output-relay";
        device = <&now_playing_dev>;
        relay-channel = <1>;
        status = "okay";
    };
};
