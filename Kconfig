## Kconfig
```kconfig
# Copyright (c) 2023 The ZMK Contributors
# SPDX-License-Identifier: MIT

config NICE_VIEW_HID
    bool "Enable nice!view display with Raw HID"
    imply ZMK_DISPLAY
    select LV_USE_IMAGE
    select LV_USE_CANVAS
    select LV_USE_MATRIX
    select LV_DRAW_TRANSFORM_USE_MATRIX
    select LV_FONT_MONTSERRAT_14
    select LV_FONT_MONTSERRAT_16
    select LV_FONT_MONTSERRAT_18
    select LV_FONT_MONTSERRAT_20

config NICE_VIEW_HID_TWO_PROFILES
    bool "Deprecated: two-profile display mode"

config NICE_VIEW_HID_SHOW_LAYOUT
    bool "Show layout"
    default y

config NICE_VIEW_HID_LAYOUTS
    string "Comma-separated layout list"
    default "EN"

config NICE_VIEW_HID_MEDIA_SCROLL
    bool "Scroll longer media text"
    default y

config NICE_VIEW_HID_INVERTED
    bool "Invert widget colors"

config LV_DPI_DEF
    default 161

config LV_Z_VDB_SIZE
    default 100

config LV_Z_BITS_PER_PIXEL
    default 1

config LV_Z_MEM_POOL_SIZE
    default 4096

choice LV_COLOR_DEPTH
    default LV_COLOR_DEPTH_1
endchoice

choice ZMK_DISPLAY_WORK_QUEUE
    default ZMK_DISPLAY_WORK_QUEUE_DEDICATED
endchoice

choice ZMK_DISPLAY_STATUS_SCREEN
    default ZMK_DISPLAY_STATUS_SCREEN_CUSTOM
endchoice
```
