## config/west.yml
```yaml
manifest:
  remotes:
    - name: zmkfirmware
      url-base: https://github.com/zmkfirmware
    - name: zzeneg
      url-base: https://github.com/zzeneg
    - name: oleksandrmaslov
      url-base: https://github.com/oleksandrmaslov
  projects:
    - name: zmk
      remote: oleksandrmaslov
      revision: hid
      import: app/west.yml
    - name: zmk-raw-hid
      remote: oleksandrmaslov
      revision: peripheral
  self:
    path: config
```
